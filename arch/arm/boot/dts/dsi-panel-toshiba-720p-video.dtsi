/* Copyright (c) 2012-2013, The Linux Foundation. All rights reserved.
 *
 * This program is free software; you can redistribute it and/or modify
 * it under the terms of the GNU General Public License version 2 and
 * only version 2 as published by the Free Software Foundation.
 *
 * This program is distributed in the hope that it will be useful,
 * but WITHOUT ANY WARRANTY; without even the implied warranty of
 * MERCHANTABILITY or FITNESS FOR A PARTICULAR PURPOSE.  See the
 * GNU General Public License for more details.
 */

/*---------------------------------------------------------------------------
 * This file is autogenerated file using gcdb parser. Please do not edit it.
 * Update input XML file to add a new entry or update variable in this file
 * VERSION = "1.0"
 *---------------------------------------------------------------------------*/
&mdss_mdp {
	dsi_tosh_720_vid: qcom,mdss_dsi_toshiba_720p_video {
		status = "ok";
		qcom,mdss-dsi-panel-name = "LGD 1080p video mode dsi panel";
		qcom,mdss-dsi-panel-controller = <&mdss_dsi0>;
		qcom,mdss-dsi-panel-type = "dsi_video_mode";
		qcom,mdss-dsi-panel-destination = "display_1";
		qcom,mdss-dsi-panel-framerate = <60>;
		qcom,mdss-dsi-virtual-channel-id = <0>;
		qcom,mdss-dsi-stream = <0>;
		qcom,mdss-dsi-panel-width = <1080>;
		qcom,mdss-dsi-panel-height = <1920>;
		qcom,mdss-dsi-h-front-porch = <110>;
		qcom,mdss-dsi-h-back-porch = <95>;
		qcom,mdss-dsi-h-pulse-width = <4>;
		qcom,mdss-dsi-h-sync-skew = <0>;
		qcom,mdss-dsi-v-back-porch = <9>;
		qcom,mdss-dsi-v-front-porch = <10>;
		qcom,mdss-dsi-v-pulse-width = <1>;
		qcom,mdss-dsi-h-left-border = <0>;
		qcom,mdss-dsi-h-right-border = <0>;
		qcom,mdss-dsi-v-top-border = <0>;
		qcom,mdss-dsi-v-bottom-border = <0>;
		qcom,mdss-dsi-bpp = <24>;
		qcom,mdss-dsi-underflow-color = <0xff>;
		qcom,mdss-dsi-border-color = <0>;
		qcom,mdss-dsi-on-command = [
15 00 00 00 00 00 02 FF 05
15 00 00 00 00 00 02 FB 01
15 00 00 00 00 00 02 C5 31
15 00 00 00 00 00 02 FF EE
15 00 00 00 00 00 02 FB 01
15 00 00 00 00 00 02 24 4F
15 00 00 00 00 00 02 38 C8
15 00 00 00 00 00 02 39 27
15 00 00 00 00 00 02 1E 77
15 00 00 00 00 00 02 1D 0F
15 00 00 00 00 00 02 7E 71
15 00 00 00 00 00 02 7C 03
15 00 00 00 00 00 02 FF 01
15 00 00 00 00 00 02 FB 01
15 00 00 00 00 00 02 00 01
15 00 00 00 00 00 02 01 55
15 00 00 00 00 00 02 02 40
15 00 00 00 00 00 02 05 40
15 00 00 00 00 00 02 06 4A
15 00 00 00 00 00 02 07 24
15 00 00 00 00 00 02 08 0C
15 00 00 00 00 00 02 0B 7D
15 00 00 00 00 00 02 0C 7D
15 00 00 00 00 00 02 0E B0
15 00 00 00 00 00 02 0F AE
15 00 00 00 00 00 02 11 10
15 00 00 00 00 00 02 12 10
15 00 00 00 00 00 02 13 03
15 00 00 00 00 00 02 14 4A
15 00 00 00 00 00 02 15 12
15 00 00 00 00 00 02 16 12
15 00 00 00 00 00 02 18 00
15 00 00 00 00 00 02 19 77
15 00 00 00 00 00 02 1A 55
15 00 00 00 00 00 02 1B 13
15 00 00 00 00 00 02 1C 00
15 00 00 00 00 00 02 1D 00
15 00 00 00 00 00 02 1E 13
15 00 00 00 00 00 02 1F 00
15 00 00 00 00 00 02 23 00
15 00 00 00 00 00 02 24 00
15 00 00 00 00 00 02 25 00
15 00 00 00 00 00 02 26 00
15 00 00 00 00 00 02 27 00
15 00 00 00 00 00 02 28 00
15 00 00 00 00 00 02 35 00
15 00 00 00 00 00 02 66 00
15 00 00 00 00 00 02 58 82
15 00 00 00 00 00 02 59 02
15 00 00 00 00 00 02 5A 02
15 00 00 00 00 00 02 5B 02
15 00 00 00 00 00 02 5C 82
15 00 00 00 00 00 02 5D 82
15 00 00 00 00 00 02 5E 02
15 00 00 00 00 00 02 5F 02
15 00 00 00 00 00 02 72 31
15 00 00 00 00 00 02 FF 05
15 00 00 00 00 00 02 FB 01
15 00 00 00 00 00 02 00 01
15 00 00 00 00 00 02 01 0B
15 00 00 00 00 00 02 02 0C
15 00 00 00 00 00 02 03 09
15 00 00 00 00 00 02 04 0A
15 00 00 00 00 00 02 05 00
15 00 00 00 00 00 02 06 0F
15 00 00 00 00 00 02 07 10
15 00 00 00 00 00 02 08 00
15 00 00 00 00 00 02 09 00
15 00 00 00 00 00 02 0A 00
15 00 00 00 00 00 02 0B 00
15 00 00 00 00 00 02 0C 00
15 00 00 00 00 00 02 0D 13
15 00 00 00 00 00 02 0E 15
15 00 00 00 00 00 02 0F 17
15 00 00 00 00 00 02 10 01
15 00 00 00 00 00 02 11 0B
15 00 00 00 00 00 02 12 0C
15 00 00 00 00 00 02 13 09
15 00 00 00 00 00 02 14 0A
15 00 00 00 00 00 02 15 00
15 00 00 00 00 00 02 16 0F
15 00 00 00 00 00 02 17 10
15 00 00 00 00 00 02 18 00
15 00 00 00 00 00 02 19 00
15 00 00 00 00 00 02 1A 00
15 00 00 00 00 00 02 1B 00
15 00 00 00 00 00 02 1C 00
15 00 00 00 00 00 02 1D 13
15 00 00 00 00 00 02 1E 15
15 00 00 00 00 00 02 1F 17
15 00 00 00 00 00 02 20 00
15 00 00 00 00 00 02 21 03
15 00 00 00 00 00 02 22 01
15 00 00 00 00 00 02 23 40
15 00 00 00 00 00 02 24 40
15 00 00 00 00 00 02 25 ED
15 00 00 00 00 00 02 29 58
15 00 00 00 00 00 02 2A 12
15 00 00 00 00 00 02 2B 01
15 00 00 00 00 00 02 4B 06
15 00 00 00 00 00 02 4C 11
15 00 00 00 00 00 02 4D 20
15 00 00 00 00 00 02 4E 02
15 00 00 00 00 00 02 4F 02
15 00 00 00 00 00 02 50 20
15 00 00 00 00 00 02 51 61
15 00 00 00 00 00 02 52 01
15 00 00 00 00 00 02 53 63
15 00 00 00 00 00 02 54 77
15 00 00 00 00 00 02 55 ED
15 00 00 00 00 00 02 5B 00
15 00 00 00 00 00 02 5C 00
15 00 00 00 00 00 02 5D 00
15 00 00 00 00 00 02 5E 00
15 00 00 00 00 00 02 5F 15
15 00 00 00 00 00 02 60 75
15 00 00 00 00 00 02 61 00
15 00 00 00 00 00 02 62 00
15 00 00 00 00 00 02 63 00
15 00 00 00 00 00 02 64 00
15 00 00 00 00 00 02 65 00
15 00 00 00 00 00 02 66 00
15 00 00 00 00 00 02 67 00
15 00 00 00 00 00 02 68 04
15 00 00 00 00 00 02 69 00
15 00 00 00 00 00 02 6A 00
15 00 00 00 00 00 02 6C 40
15 00 00 00 00 00 02 75 01
15 00 00 00 00 00 02 76 01
15 00 00 00 00 00 02 7A 80
15 00 00 00 00 00 02 7B A3
15 00 00 00 00 00 02 7C D8
15 00 00 00 00 00 02 7D 60
15 00 00 00 00 00 02 7F 15
15 00 00 00 00 00 02 80 81
15 00 00 00 00 00 02 83 05
15 00 00 00 00 00 02 93 08
15 00 00 00 00 00 02 94 10
15 00 00 00 00 00 02 8A 00
15 00 00 00 00 00 02 9B 0F
/*15 00 00 00 00 00 02 FF 01
15 00 00 00 00 00 02 FB 01
15 00 00 00 00 00 02 75 01
15 00 00 00 00 00 02 76 50
15 00 00 00 00 00 02 77 01
15 00 00 00 00 00 02 78 52
15 00 00 00 00 00 02 79 01
15 00 00 00 00 00 02 7A 58
15 00 00 00 00 00 02 7B 01
15 00 00 00 00 00 02 7C 5D
15 00 00 00 00 00 02 7D 01
15 00 00 00 00 00 02 7E 62
15 00 00 00 00 00 02 7F 01
15 00 00 00 00 00 02 80 67
15 00 00 00 00 00 02 81 01
15 00 00 00 00 00 02 82 6C
15 00 00 00 00 00 02 83 01
15 00 00 00 00 00 02 84 71
15 00 00 00 00 00 02 85 01
15 00 00 00 00 00 02 86 76
15 00 00 00 00 00 02 87 01
15 00 00 00 00 00 02 88 89
15 00 00 00 00 00 02 89 01
15 00 00 00 00 00 02 8A 9A
15 00 00 00 00 00 02 8B 01
15 00 00 00 00 00 02 8C BA
15 00 00 00 00 00 02 8D 01
15 00 00 00 00 00 02 8E D7
15 00 00 00 00 00 02 8F 02
15 00 00 00 00 00 02 90 0A
15 00 00 00 00 00 02 91 02
15 00 00 00 00 00 02 92 3A
15 00 00 00 00 00 02 93 02
15 00 00 00 00 00 02 94 3B
15 00 00 00 00 00 02 95 02
15 00 00 00 00 00 02 96 68
15 00 00 00 00 00 02 97 02
15 00 00 00 00 00 02 98 9C
15 00 00 00 00 00 02 99 02
15 00 00 00 00 00 02 9A BE
15 00 00 00 00 00 02 9B 02
15 00 00 00 00 00 02 9C F0
15 00 00 00 00 00 02 9D 03
15 00 00 00 00 00 02 9E 17
15 00 00 00 00 00 02 9F 03
15 00 00 00 00 00 02 A0 5E
15 00 00 00 00 00 02 A2 03
15 00 00 00 00 00 02 A3 76
15 00 00 00 00 00 02 A4 03
15 00 00 00 00 00 02 A5 84
15 00 00 00 00 00 02 A6 03
15 00 00 00 00 00 02 A7 94
15 00 00 00 00 00 02 A9 03
15 00 00 00 00 00 02 AA A5
15 00 00 00 00 00 02 AB 03
15 00 00 00 00 00 02 AC B9
15 00 00 00 00 00 02 AD 03
15 00 00 00 00 00 02 AE C1
15 00 00 00 00 00 02 AF 03
15 00 00 00 00 00 02 B0 C6
15 00 00 00 00 00 02 B1 03
15 00 00 00 00 00 02 B2 CB
15 00 00 00 00 00 02 B3 01
15 00 00 00 00 00 02 B4 50
15 00 00 00 00 00 02 B5 01
15 00 00 00 00 00 02 B6 52
15 00 00 00 00 00 02 B7 01
15 00 00 00 00 00 02 B8 58
15 00 00 00 00 00 02 B9 01
15 00 00 00 00 00 02 BA 5D
15 00 00 00 00 00 02 BB 01
15 00 00 00 00 00 02 BC 62
15 00 00 00 00 00 02 BD 01
15 00 00 00 00 00 02 BE 67
15 00 00 00 00 00 02 BF 01
15 00 00 00 00 00 02 C0 6C
15 00 00 00 00 00 02 C1 01
15 00 00 00 00 00 02 C2 71
15 00 00 00 00 00 02 C3 01
15 00 00 00 00 00 02 C4 76
15 00 00 00 00 00 02 C5 01
15 00 00 00 00 00 02 C6 89
15 00 00 00 00 00 02 C7 01
15 00 00 00 00 00 02 C8 9A
15 00 00 00 00 00 02 C9 01
15 00 00 00 00 00 02 CA BA
15 00 00 00 00 00 02 CB 01
15 00 00 00 00 00 02 CC D7
15 00 00 00 00 00 02 CD 02
15 00 00 00 00 00 02 CE 0A
15 00 00 00 00 00 02 CF 02
15 00 00 00 00 00 02 D0 3A
15 00 00 00 00 00 02 D1 02
15 00 00 00 00 00 02 D2 3B
15 00 00 00 00 00 02 D3 02
15 00 00 00 00 00 02 D4 68
15 00 00 00 00 00 02 D5 02
15 00 00 00 00 00 02 D6 9C
15 00 00 00 00 00 02 D7 02
15 00 00 00 00 00 02 D8 BE
15 00 00 00 00 00 02 D9 02
15 00 00 00 00 00 02 DA F0
15 00 00 00 00 00 02 DB 03
15 00 00 00 00 00 02 DC 17
15 00 00 00 00 00 02 DD 03
15 00 00 00 00 00 02 DE 5E
15 00 00 00 00 00 02 DF 03
15 00 00 00 00 00 02 E0 76
15 00 00 00 00 00 02 E1 03
15 00 00 00 00 00 02 E2 84
15 00 00 00 00 00 02 E3 03
15 00 00 00 00 00 02 E4 94
15 00 00 00 00 00 02 E5 03
15 00 00 00 00 00 02 E6 A5
15 00 00 00 00 00 02 E7 03
15 00 00 00 00 00 02 E8 B9
15 00 00 00 00 00 02 E9 03
15 00 00 00 00 00 02 EA C1
15 00 00 00 00 00 02 EB 03
15 00 00 00 00 00 02 EC C6
15 00 00 00 00 00 02 ED 03
15 00 00 00 00 00 02 EE CB
15 00 00 00 00 00 02 EF 01
15 00 00 00 00 00 02 F0 00
15 00 00 00 00 00 02 F1 01
15 00 00 00 00 00 02 F2 04
15 00 00 00 00 00 02 F3 01
15 00 00 00 00 00 02 F4 0C
15 00 00 00 00 00 02 F5 01
15 00 00 00 00 00 02 F6 13
15 00 00 00 00 00 02 F7 01
15 00 00 00 00 00 02 F8 1B
15 00 00 00 00 00 02 F9 01
15 00 00 00 00 00 02 FA 23
15 00 00 00 00 00 02 FF 02
15 00 00 00 00 00 02 FB 01
15 00 00 00 00 00 02 00 01
15 00 00 00 00 00 02 01 2A
15 00 00 00 00 00 02 02 01
15 00 00 00 00 00 02 03 31
15 00 00 00 00 00 02 04 01
15 00 00 00 00 00 02 05 37
15 00 00 00 00 00 02 06 01
15 00 00 00 00 00 02 07 51
15 00 00 00 00 00 02 08 01
15 00 00 00 00 00 02 09 68
15 00 00 00 00 00 02 0A 01
15 00 00 00 00 00 02 0B 91
15 00 00 00 00 00 02 0C 01
15 00 00 00 00 00 02 0D B6
15 00 00 00 00 00 02 0E 01
15 00 00 00 00 00 02 0F F2
15 00 00 00 00 00 02 10 02
15 00 00 00 00 00 02 11 26
15 00 00 00 00 00 02 12 02
15 00 00 00 00 00 02 13 27
15 00 00 00 00 00 02 14 02
15 00 00 00 00 00 02 15 57
15 00 00 00 00 00 02 16 02
15 00 00 00 00 00 02 17 8D
15 00 00 00 00 00 02 18 02
15 00 00 00 00 00 02 19 B0
15 00 00 00 00 00 02 1A 02
15 00 00 00 00 00 02 1B DF
15 00 00 00 00 00 02 1C 03
15 00 00 00 00 00 02 1D 00
15 00 00 00 00 00 02 1E 03
15 00 00 00 00 00 02 1F 2B
15 00 00 00 00 00 02 20 03
15 00 00 00 00 00 02 21 38
15 00 00 00 00 00 02 22 03
15 00 00 00 00 00 02 23 46
15 00 00 00 00 00 02 24 03
15 00 00 00 00 00 02 25 55
15 00 00 00 00 00 02 26 03
15 00 00 00 00 00 02 27 64
15 00 00 00 00 00 02 28 03
15 00 00 00 00 00 02 29 75
15 00 00 00 00 00 02 2A 03
15 00 00 00 00 00 02 2B 85
15 00 00 00 00 00 02 2D 03
15 00 00 00 00 00 02 2F 90
15 00 00 00 00 00 02 30 03
15 00 00 00 00 00 02 31 CB
15 00 00 00 00 00 02 32 01
15 00 00 00 00 00 02 33 00
15 00 00 00 00 00 02 34 01
15 00 00 00 00 00 02 35 04
15 00 00 00 00 00 02 36 01
15 00 00 00 00 00 02 37 0C
15 00 00 00 00 00 02 38 01
15 00 00 00 00 00 02 39 13
15 00 00 00 00 00 02 3A 01
15 00 00 00 00 00 02 3B 1B
15 00 00 00 00 00 02 3D 01
15 00 00 00 00 00 02 3F 23
15 00 00 00 00 00 02 40 01
15 00 00 00 00 00 02 41 2A
15 00 00 00 00 00 02 42 01
15 00 00 00 00 00 02 43 31
15 00 00 00 00 00 02 44 01
15 00 00 00 00 00 02 45 37
15 00 00 00 00 00 02 46 01
15 00 00 00 00 00 02 47 51
15 00 00 00 00 00 02 48 01
15 00 00 00 00 00 02 49 68
15 00 00 00 00 00 02 4A 01
15 00 00 00 00 00 02 4B 91
15 00 00 00 00 00 02 4C 01
15 00 00 00 00 00 02 4D B6
15 00 00 00 00 00 02 4E 01
15 00 00 00 00 00 02 4F F2
15 00 00 00 00 00 02 50 02
15 00 00 00 00 00 02 51 26
15 00 00 00 00 00 02 52 02
15 00 00 00 00 00 02 53 27
15 00 00 00 00 00 02 54 02
15 00 00 00 00 00 02 55 57
15 00 00 00 00 00 02 56 02
15 00 00 00 00 00 02 58 8D
15 00 00 00 00 00 02 59 02
15 00 00 00 00 00 02 5A B0
15 00 00 00 00 00 02 5B 02
15 00 00 00 00 00 02 5C DF
15 00 00 00 00 00 02 5D 03
15 00 00 00 00 00 02 5E 00
15 00 00 00 00 00 02 5F 03
15 00 00 00 00 00 02 60 2B
15 00 00 00 00 00 02 61 03
15 00 00 00 00 00 02 62 38
15 00 00 00 00 00 02 63 03
15 00 00 00 00 00 02 64 46
15 00 00 00 00 00 02 65 03
15 00 00 00 00 00 02 66 55
15 00 00 00 00 00 02 67 03
15 00 00 00 00 00 02 68 64
15 00 00 00 00 00 02 69 03
15 00 00 00 00 00 02 6A 75
15 00 00 00 00 00 02 6B 03
15 00 00 00 00 00 02 6C 85
15 00 00 00 00 00 02 6D 03
15 00 00 00 00 00 02 6E 90
15 00 00 00 00 00 02 6F 03
15 00 00 00 00 00 02 70 CB
15 00 00 00 00 00 02 71 00
15 00 00 00 00 00 02 72 00
15 00 00 00 00 00 02 73 00
15 00 00 00 00 00 02 74 0A
15 00 00 00 00 00 02 75 00
15 00 00 00 00 00 02 76 2A
15 00 00 00 00 00 02 77 00
15 00 00 00 00 00 02 78 41
15 00 00 00 00 00 02 79 00
15 00 00 00 00 00 02 7A 56
15 00 00 00 00 00 02 7B 00
15 00 00 00 00 00 02 7C 69
15 00 00 00 00 00 02 7D 00
15 00 00 00 00 00 02 7E 7A
15 00 00 00 00 00 02 7F 00
15 00 00 00 00 00 02 80 8A
15 00 00 00 00 00 02 81 00
15 00 00 00 00 00 02 82 98
15 00 00 00 00 00 02 83 00
15 00 00 00 00 00 02 84 CB
15 00 00 00 00 00 02 85 00
15 00 00 00 00 00 02 86 F5
15 00 00 00 00 00 02 87 01
15 00 00 00 00 00 02 88 38
15 00 00 00 00 00 02 89 01
15 00 00 00 00 00 02 8A 6E
15 00 00 00 00 00 02 8B 01
15 00 00 00 00 00 02 8C C4
15 00 00 00 00 00 02 8D 02
15 00 00 00 00 00 02 8E 07
15 00 00 00 00 00 02 8F 02
15 00 00 00 00 00 02 90 09
15 00 00 00 00 00 02 91 02
15 00 00 00 00 00 02 92 43
15 00 00 00 00 00 02 93 02
15 00 00 00 00 00 02 94 7E
15 00 00 00 00 00 02 95 02
15 00 00 00 00 00 02 96 A2
15 00 00 00 00 00 02 97 02
15 00 00 00 00 00 02 98 D4
15 00 00 00 00 00 02 99 02
15 00 00 00 00 00 02 9A FC
15 00 00 00 00 00 02 9B 03
15 00 00 00 00 00 02 9C 38
15 00 00 00 00 00 02 9D 03
15 00 00 00 00 00 02 9E 58
15 00 00 00 00 00 02 9F 03
15 00 00 00 00 00 02 A0 70
15 00 00 00 00 00 02 A2 03
15 00 00 00 00 00 02 A3 81
15 00 00 00 00 00 02 A4 03
15 00 00 00 00 00 02 A5 93
15 00 00 00 00 00 02 A6 03
15 00 00 00 00 00 02 A7 A8
15 00 00 00 00 00 02 A9 03
15 00 00 00 00 00 02 AA B0
15 00 00 00 00 00 02 AB 03
15 00 00 00 00 00 02 AC C0
15 00 00 00 00 00 02 AD 03
15 00 00 00 00 00 02 AE CB
15 00 00 00 00 00 02 AF 00
15 00 00 00 00 00 02 B0 00
15 00 00 00 00 00 02 B1 00
15 00 00 00 00 00 02 B2 0A
15 00 00 00 00 00 02 B3 00
15 00 00 00 00 00 02 B4 2A
15 00 00 00 00 00 02 B5 00
15 00 00 00 00 00 02 B6 41
15 00 00 00 00 00 02 B7 00
15 00 00 00 00 00 02 B8 56
15 00 00 00 00 00 02 B9 00
15 00 00 00 00 00 02 BA 69
15 00 00 00 00 00 02 BB 00
15 00 00 00 00 00 02 BC 7A
15 00 00 00 00 00 02 BD 00
15 00 00 00 00 00 02 BE 8A
15 00 00 00 00 00 02 BF 00
15 00 00 00 00 00 02 C0 98
15 00 00 00 00 00 02 C1 00
15 00 00 00 00 00 02 C2 CB
15 00 00 00 00 00 02 C3 00
15 00 00 00 00 00 02 C4 F5
15 00 00 00 00 00 02 C5 01
15 00 00 00 00 00 02 C6 38
15 00 00 00 00 00 02 C7 01
15 00 00 00 00 00 02 C8 6E
15 00 00 00 00 00 02 C9 01
15 00 00 00 00 00 02 CA C4
15 00 00 00 00 00 02 CB 02
15 00 00 00 00 00 02 CC 07
15 00 00 00 00 00 02 CD 02
15 00 00 00 00 00 02 CE 09
15 00 00 00 00 00 02 CF 02
15 00 00 00 00 00 02 D0 43
15 00 00 00 00 00 02 D1 02
15 00 00 00 00 00 02 D2 7E
15 00 00 00 00 00 02 D3 02
15 00 00 00 00 00 02 D4 A2
15 00 00 00 00 00 02 D5 02
15 00 00 00 00 00 02 D6 D4
15 00 00 00 00 00 02 D7 02
15 00 00 00 00 00 02 D8 FC
15 00 00 00 00 00 02 D9 03
15 00 00 00 00 00 02 DA 38
15 00 00 00 00 00 02 DB 03
15 00 00 00 00 00 02 DC 58
15 00 00 00 00 00 02 DD 03
15 00 00 00 00 00 02 DE 70
15 00 00 00 00 00 02 DF 03
15 00 00 00 00 00 02 E0 81
15 00 00 00 00 00 02 E1 03
15 00 00 00 00 00 02 E2 93
15 00 00 00 00 00 02 E3 03
15 00 00 00 00 00 02 E4 A8
15 00 00 00 00 00 02 E5 03
15 00 00 00 00 00 02 E6 B0
15 00 00 00 00 00 02 E7 03
15 00 00 00 00 00 02 E8 C0
15 00 00 00 00 00 02 E9 03
15 00 00 00 00 00 02 EA CB*/
15 00 00 00 00 00 02 FF 03
15 00 00 00 00 00 02 FB 01
15 00 00 00 00 00 02 00 44
15 00 00 00 00 00 02 01 48
15 00 00 00 00 00 02 02 4C
15 00 00 00 00 00 02 03 50
15 00 00 00 00 00 02 04 50
15 00 00 00 00 00 02 05 50
15 00 00 00 00 00 02 06 50
15 00 00 00 00 00 02 07 50
15 00 00 00 00 00 02 08 50
15 00 00 00 00 00 02 09 50
15 00 00 00 00 00 02 0A 48
15 00 00 00 00 00 02 0B 40
15 00 00 00 00 00 02 0C 38
15 00 00 00 00 00 02 0D 30
15 00 00 00 00 00 02 0E 28
15 00 00 00 00 00 02 0F 28
15 00 00 00 00 00 02 10 28
15 00 00 00 00 00 02 11 28
15 00 00 00 00 00 02 12 28
15 00 00 00 00 00 02 13 28
15 00 00 00 00 00 02 1B 44
15 00 00 00 00 00 02 1C 48
15 00 00 00 00 00 02 1D 4C
15 00 00 00 00 00 02 1E 50
15 00 00 00 00 00 02 1F 4C
15 00 00 00 00 00 02 20 48
15 00 00 00 00 00 02 21 44
15 00 00 00 00 00 02 22 3C
15 00 00 00 00 00 02 23 34
15 00 00 00 00 00 02 24 2C
15 00 00 00 00 00 02 25 24
15 00 00 00 00 00 02 26 1C
15 00 00 00 00 00 02 27 1C
15 00 00 00 00 00 02 28 1C
15 00 00 00 00 00 02 29 1C
15 00 00 00 00 00 02 2A 1C
15 00 00 00 00 00 02 2B 1C
15 00 00 00 00 00 02 2F 1C
15 00 00 00 00 00 02 30 1C
15 00 00 00 00 00 02 31 1C
15 00 00 00 00 00 02 32 88
15 00 00 00 00 00 02 33 88
15 00 00 00 00 00 02 34 88
15 00 00 00 00 00 02 35 08
15 00 00 00 00 00 02 36 08
15 00 00 00 00 00 02 37 08
15 00 00 00 00 00 02 38 08
15 00 00 00 00 00 02 39 08
15 00 00 00 00 00 02 3A 08
15 00 00 00 00 00 02 3B 08
15 00 00 00 00 00 02 3F 08
15 00 00 00 00 00 02 40 08
15 00 00 00 00 00 02 41 08
15 00 00 00 00 00 02 42 08
15 00 00 00 00 00 02 43 08
15 00 00 00 00 00 02 44 08
15 00 00 00 00 00 02 45 08
15 00 00 00 00 00 02 46 08
15 00 00 00 00 00 02 47 08
15 00 00 00 00 00 02 48 08
15 00 00 00 00 00 02 49 08
15 00 00 00 00 00 02 4A 08
15 00 00 00 00 00 02 4B 08
15 00 00 00 00 00 02 4C 88
15 00 00 00 00 00 02 4D 00
15 00 00 00 00 00 02 4E 08
15 00 00 00 00 00 02 4F 10
15 00 00 00 00 00 02 50 18
15 00 00 00 00 00 02 51 20
15 00 00 00 00 00 02 52 28
15 00 00 00 00 00 02 60 52
15 00 00 00 00 00 02 61 63
15 00 00 00 00 00 02 62 74
15 00 00 00 00 00 02 1A 00
15 00 00 00 00 00 02 53 00
15 00 00 00 00 00 02 54 00
15 00 00 00 00 00 02 5B 00
15 00 00 00 00 00 02 63 00
15 00 00 00 00 00 02 FF 00

						15 00 00 00 00 00 02 FF 01
						15 00 00 00 00 00 02 FB 01
						15 00 00 00 00 00 02 FF 02
						15 00 00 00 00 00 02 FB 01
						15 00 00 00 00 00 02 FF 04
						15 00 00 00 00 00 02 FB 01
						15 00 00 00 00 00 02 08 03
						15 00 00 00 00 00 02 FF 00
						15 00 00 00 00 00 02 D3 0C
						15 00 00 00 00 00 02 D4 09
						//05 01 00 00 78 00 02 11 00
						15 00 00 00 00 00 02 FF 00
						15 00 00 00 00 00 02 34 00
						15 00 00 00 00 00 02 35 00
						//05 01 00 00 78 00 02 29 00
						15 00 00 00 00 00 02 5e 00
						15 00 00 00 00 00 02 53 2c
						//15 00 00 00 00 00 02 55 83
15 00 00 00 00 00 02 FF 03
15 00 00 00 00 00 02 FB 01
15 00 00 00 00 00 02 00 44
15 00 00 00 00 00 02 01 48
15 00 00 00 00 00 02 02 4C
15 00 00 00 00 00 02 03 50
15 00 00 00 00 00 02 04 50
15 00 00 00 00 00 02 05 50
15 00 00 00 00 00 02 06 50
15 00 00 00 00 00 02 07 50
15 00 00 00 00 00 02 08 50
15 00 00 00 00 00 02 09 50
15 00 00 00 00 00 02 0A 48
15 00 00 00 00 00 02 0B 40
15 00 00 00 00 00 02 0C 38
15 00 00 00 00 00 02 0D 30
15 00 00 00 00 00 02 0E 28
15 00 00 00 00 00 02 0F 28
15 00 00 00 00 00 02 10 28
15 00 00 00 00 00 02 11 28
15 00 00 00 00 00 02 12 28
15 00 00 00 00 00 02 13 28
15 00 00 00 00 00 02 1B 44
15 00 00 00 00 00 02 1C 48
15 00 00 00 00 00 02 1D 4C
15 00 00 00 00 00 02 1E 50
15 00 00 00 00 00 02 1F 4C
15 00 00 00 00 00 02 20 48
15 00 00 00 00 00 02 21 44
15 00 00 00 00 00 02 22 3C
15 00 00 00 00 00 02 23 34
15 00 00 00 00 00 02 24 2C
15 00 00 00 00 00 02 25 24
15 00 00 00 00 00 02 26 1C
15 00 00 00 00 00 02 27 1C
15 00 00 00 00 00 02 28 1C
15 00 00 00 00 00 02 29 1C
15 00 00 00 00 00 02 2A 1C
15 00 00 00 00 00 02 2B 1C
15 00 00 00 00 00 02 2F 1C
15 00 00 00 00 00 02 30 1C
15 00 00 00 00 00 02 31 1C
15 00 00 00 00 00 02 32 88
15 00 00 00 00 00 02 33 88
15 00 00 00 00 00 02 34 88
15 00 00 00 00 00 02 35 08
15 00 00 00 00 00 02 36 08
15 00 00 00 00 00 02 37 08
15 00 00 00 00 00 02 38 08
15 00 00 00 00 00 02 39 08
15 00 00 00 00 00 02 3A 08
15 00 00 00 00 00 02 3B 08
15 00 00 00 00 00 02 3F 08
15 00 00 00 00 00 02 40 08
15 00 00 00 00 00 02 41 08
15 00 00 00 00 00 02 42 08
15 00 00 00 00 00 02 43 08
15 00 00 00 00 00 02 44 08
15 00 00 00 00 00 02 45 08
15 00 00 00 00 00 02 46 08
15 00 00 00 00 00 02 47 08
15 00 00 00 00 00 02 48 08
15 00 00 00 00 00 02 49 08
15 00 00 00 00 00 02 4A 08
15 00 00 00 00 00 02 4B 08
15 00 00 00 00 00 02 4C 88
15 00 00 00 00 00 02 4D 00
15 00 00 00 00 00 02 4E 08
15 00 00 00 00 00 02 4F 18
15 00 00 00 00 00 02 50 00
15 00 00 00 00 00 02 51 08
15 00 00 00 00 00 02 52 18
15 00 00 00 00 00 02 1A 00
15 00 00 00 00 00 02 53 66
15 00 00 00 00 00 02 54 66
15 00 00 00 00 00 02 5B 00
15 00 00 00 00 00 02 63 00
15 00 00 00 00 00 02 60 66
15 00 00 00 00 00 02 61 66
15 00 00 00 00 00 02 62 66
15 01 00 00 00 00 02 FF 00];
		qcom,mdss-dsi-off-command = [05 01 00 00 32 00 02 28 00
				 05 01 00 00 78 00 02 10 00];
		qcom,mdss-dsi-on-command-state = "dsi_lp_mode";
		qcom,mdss-dsi-off-command-state = "dsi_hs_mode";
		qcom,mdss-dsi-h-sync-pulse = <0>;
		qcom,mdss-dsi-traffic-mode = "non_burst_sync_event";
		qcom,mdss-dsi-bllp-eof-power-mode;
		qcom,mdss-dsi-bllp-power-mode;
		qcom,mdss-dsi-lane-0-state;
		qcom,mdss-dsi-lane-1-state;
		qcom,mdss-dsi-lane-2-state;
		qcom,mdss-dsi-lane-3-state;
		qcom,mdss-dsi-panel-timings = [e5 38 26 00 69 72  
		                                2b 3b 41 03 04 00];
		qcom,mdss-dsi-t-clk-post = <0x04>;
		qcom,mdss-dsi-t-clk-pre = <0x1b>;
		qcom,mdss-dsi-bl-min-level = <1>;
		qcom,mdss-dsi-bl-max-level = <4095>;
		qcom,mdss-dsi-dma-trigger = "trigger_sw";
		qcom,mdss-dsi-mdp-trigger = "none";
		qcom,mdss-dsi-bl-pmic-control-type = "bl_ctrl_wled";
		qcom,mdss-dsi-pan-enable-dynamic-fps;
		qcom,mdss-dsi-pan-fps-update = "dfps_suspend_resume_mode";
		qcom,mdss-dsi-reset-sequence = <1 20>, <0 200>, <1 20>;
	};
};
